## boards/shields/numPad/Kconfig.defconfig
```kconfig
# 
# Kconfig defconfig
# 
# Created: 2025-Aug-09 17:43
# 
# Edited: 2025-Aug-09 19:23
if SHIELD_NUMPAD

# Name must be less than 16 characters long!
config ZMK_KEYBOARD_NAME
    default "NummyBad"

endif
```

## boards/shields/numPad/Kconfig.shield
```kconfig
# 
# Kconfig shield
# 
# Created: 2025-Aug-09 17:43
# 
# Edited: 2025-Aug-09 19:24
# 

# No whitespace after the comma or in your keyboard name!
config SHIELD_NUMPAD
    def_bool $(shields_list_contains,numpad)
```
